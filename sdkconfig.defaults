## sdkconfig.defaults
```kconfig
# ESP32-S3 SDK Configuration for SENTARA Project
CONFIG_ESP_TASK_WDT_TIMEOUT_S=10
CONFIG_FREERTOS_HZ=1000
CONFIG_ESP_MAIN_TASK_STACK_SIZE=65536

# Enable UART logging
CONFIG_LOG_DEFAULT_LEVEL_INFO=y
CONFIG_LOG_MAXIMUM_LEVEL_VERBOSE=y

# Memory configuration
CONFIG_ESP32S3_DATA_CACHE_SIZE_32KB=y
CONFIG_ESP32S3_INSTRUCTION_CACHE_32KB=y

# Partition table
CONFIG_PARTITION_TABLE_SINGLE_APP=y
```
